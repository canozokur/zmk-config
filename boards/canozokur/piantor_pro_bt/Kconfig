## boards/canozokur/piantor_pro_bt/Kconfig
```kconfig
# SPDX-License-Identifier: MIT

config BOARD_PIANTOR_PRO_BT_LEFT
    select SOC_NRF52840_QIAA

config BOARD_PIANTOR_PRO_BT_RIGHT
    select SOC_NRF52840_QIAA
```

## boards/canozokur/piantor_pro_bt/Kconfig.piantor_pro_bt
```kconfig
# Copyright (c) 2020 The ZMK Contributors
# SPDX-License-Identifier: MIT

config BOARD_PIANTOR_PRO_BT_LEFT
	bool "Piantor Pro BT Left"
	select SOC_NRF52840_QIAA

config BOARD_PIANTOR_PRO_BT_RIGHT
    bool "Piantor Pro BT Right"
    select SOC_NRF52840_QIAA
```

## boards/canozokur/piantor_pro_bt/board.yml
```yaml
boards:
  - name: piantor_pro_bt_left
    vendor: canozokur
    socs:
      - name: nrf52840
  - name: piantor_pro_bt_right
    vendor: canozokur
    socs:
      - name: nrf52840
```

## config/west.yml
```yaml
manifest:
  remotes:
    - name: zmkfirmware
      url-base: https://github.com/zmkfirmware
    # urob's zmk helpers
    - name: urob
      url-base: https://github.com/urob
  projects:
    - name: zmk
      remote: zmkfirmware
      revision: main
      import: app/west.yml
    - name: zmk-helpers
      remote: urob
      revision: main
  self:
    path: config
```
